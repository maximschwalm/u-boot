// SPDX-License-Identifier: GPL-2.0
/dts-v1/;

#include <dt-bindings/input/input.h>

#include "tegra30-asus-transformer.dtsi"

/ {
	model = "ASUS Transformer Pad Infinity TF700T";
	compatible = "asus,tf700t", "nvidia,tegra30";
};

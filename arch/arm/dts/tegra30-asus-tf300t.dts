// SPDX-License-Identifier: GPL-2.0
/dts-v1/;

#include <dt-bindings/input/input.h>

#include "tegra30-asus-lvds-display.dtsi"
#include "tegra30-asus-transformer.dtsi"

/ {
	model = "ASUS Transformer Pad TF300T";
	compatible = "asus,tf300t", "nvidia,tegra30";
};

&gpio {
	volume-buttons-hog {
		gpio-hog;
		gpios = <TEGRA_GPIO(R, 0) GPIO_ACTIVE_HIGH>,
			<TEGRA_GPIO(K, 7) GPIO_ACTIVE_HIGH>;
		output-low;
	};
};
